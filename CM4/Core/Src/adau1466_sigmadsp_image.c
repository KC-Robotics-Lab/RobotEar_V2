#include "adau1466_sigmadsp_image.h"
#include <stddef.h>
#include <stdint.h>

volatile uint16_t g_adau1466_sigma_last_address = 0xFFFFU;
volatile HAL_StatusTypeDef g_adau1466_sigma_last_status = HAL_OK;


/*
 * Generated from SigmaStudio Link-Compile-Download capture:
 *   붙여넣은 텍스트 (1)(93).txt
 *
 * I2C control-port version:
 * - Three SPI Toggle writes and their delays are intentionally omitted.
 * - All remaining writes and delays preserve the capture order.
 * - Program RAM, DM0 RAM and DM1 RAM are copied byte-for-byte.
 *
 * Image sizes:
 * - Program RAM: 11240 bytes at 0xC000
 * - DM0 RAM    : 1740 bytes at 0x0000
 * - DM1 RAM    : 272 bytes at 0x6000
 */


static const uint8_t s_program_data[11240] = {
    0x00U, 0x00U, 0x00U, 0x02U, 0x0CU, 0x00U, 0xDCU, 0xDCU, 0x0DU, 0x00U, 0xFFU, 0xD2U,
    0x0DU, 0x00U, 0xFFU, 0xD0U, 0x0DU, 0x00U, 0xF4U, 0x50U, 0x0DU, 0x00U, 0xF4U, 0x00U,
    0xC0U, 0x00U, 0x23U, 0x80U, 0x80U, 0x00U, 0x00U, 0x00U, 0xC0U, 0x00U, 0x23U, 0x00U,
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    0x00U, 0x00U, 0x00U, 0x00U, 0x00U, 0x00U, 0x00U, 0x00U
};


static const uint8_t s_dm0_data[1740] = {
    0x00U, 0x00U, 0x00U, 0x00U, 0x00U, 0x00U, 0x00U, 0x00U, 0x00U, 0x00U, 0x00U, 0x00U,
    0x00U, 0x00U, 0x00U, 0x00U, 0x00U, 0x00U, 0x00U, 0x00U, 0x00U, 0x00U, 0x00U, 0x00U,
    0x00U, 0x00U, 0x00U, 0x00U, 0x00U, 0x00U, 0x00U, 0x00U, 0x00U, 0x00U, 0x00U, 0x00U,
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    0x00U, 0x00U, 0x00U, 0x00U, 0x00U, 0x00U, 0x00U, 0x00U, 0x00U, 0x00U, 0x00U, 0x00U
};


static const uint8_t s_dm1_data[272] = {
    0x00U, 0x00U, 0x00U, 0x00U, 0x00U, 0x00U, 0x00U, 0x00U, 0x00U, 0x00U, 0x00U, 0x00U,
    0x00U, 0x00U, 0x00U, 0x00U, 0x00U, 0x00U, 0x00U, 0x00U, 0x00U, 0x00U, 0x00U, 0x00U,
    0x00U, 0x00U, 0x00U, 0x00U, 0x00U, 0x00U, 0x00U, 0x00U, 0x00U, 0x00U, 0x00U, 0x00U,
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    0x00U, 0x00U, 0x00U, 0x00U, 0x00U, 0x00U, 0x00U, 0x00U
};


static HAL_StatusTypeDef adau1466_write_block(I2C_HandleTypeDef *hi2c,
                                                uint16_t device_address_8bit,
                                                uint16_t subaddress,
                                                const uint8_t *data,
                                                uint16_t length)
{
    if ((hi2c == NULL) || (data == NULL) || (length == 0U))
    {
        g_adau1466_sigma_last_address = subaddress;
        g_adau1466_sigma_last_status = HAL_ERROR;
        return HAL_ERROR;
    }

    g_adau1466_sigma_last_address = subaddress;
    g_adau1466_sigma_last_status =
        HAL_I2C_Mem_Write(hi2c,
                          device_address_8bit,
                          subaddress,
                          I2C_MEMADD_SIZE_16BIT,
                          (uint8_t *)(uintptr_t)data,
                          length,
                          ADAU1466_SIGMA_I2C_TIMEOUT_MS);

    return g_adau1466_sigma_last_status;
}

static HAL_StatusTypeDef adau1466_write_u16(I2C_HandleTypeDef *hi2c,
                                            uint16_t device_address_8bit,
                                            uint16_t subaddress,
                                            uint16_t value)
{
    const uint8_t bytes[2] =
    {
        (uint8_t)((value >> 8) & 0xFFU),
        (uint8_t)(value & 0xFFU)
    };

    return adau1466_write_block(hi2c,
                                device_address_8bit,
                                subaddress,
                                bytes,
                                (uint16_t)sizeof(bytes));
}

#define ADAU_TRY(expression_)            \
    do                                  \
    {                                   \
        HAL_StatusTypeDef status_;      \
        status_ = (expression_);         \
        if (status_ != HAL_OK)           \
        {                                \
            return status_;             \
        }                                \
    } while (0)

HAL_StatusTypeDef ADAU1466_LoadSigmaStudioImage(I2C_HandleTypeDef *hi2c, uint16_t device_address_8bit, uint8_t flag)
{
    if ((hi2c == NULL) || (device_address_8bit == 0U))
    {
        g_adau1466_sigma_last_address = 0xFFFFU;
        g_adau1466_sigma_last_status = HAL_ERROR;
        return HAL_ERROR;
    }

    /* device_address_8bit is the STM32 HAL address, for example 0x38 << 1. */
    g_adau1466_sigma_last_address = 0xFFFFU;
    g_adau1466_sigma_last_status =
        HAL_I2C_IsDeviceReady(hi2c,
                              device_address_8bit,
                              3U,
                              ADAU1466_SIGMA_I2C_TIMEOUT_MS);

    if (g_adau1466_sigma_last_status != HAL_OK)
    {
        return g_adau1466_sigma_last_status;
    }

    ADAU_TRY(adau1466_write_u16(hi2c, device_address_8bit, 0xF899U, 0x0001U)); /* IC 1.SECOND_PAGE_ENABLE */

    ADAU_TRY(adau1466_write_u16(hi2c, device_address_8bit, 0xF899U, 0x0000U)); /* IC 1.SECOND_PAGE_ENABLE */

    ADAU_TRY(adau1466_write_u16(hi2c, device_address_8bit, 0xF890U, 0x0000U)); /* IC 1.SOFT_RESET */

    ADAU_TRY(adau1466_write_u16(hi2c, device_address_8bit, 0xF890U, 0x0001U)); /* IC 1.SOFT_RESET */

    HAL_Delay(255U); /* IC 1.Reset Delay */

    ADAU_TRY(adau1466_write_u16(hi2c, device_address_8bit, 0xF400U, 0x0000U)); /* IC 1.HIBERNATE */

    ADAU_TRY(adau1466_write_u16(hi2c, device_address_8bit, 0xF400U, 0x0001U)); /* IC 1.HIBERNATE */

    HAL_Delay(255U); /* IC 1.Hibernate Delay */

    ADAU_TRY(adau1466_write_u16(hi2c, device_address_8bit, 0xF403U, 0x0000U)); /* IC 1.KILL_CORE */

    ADAU_TRY(adau1466_write_u16(hi2c, device_address_8bit, 0xF403U, 0x0001U)); /* IC 1.KILL_CORE */

    ADAU_TRY(adau1466_write_u16(hi2c, device_address_8bit, 0xF003U, 0x0000U)); /* IC 1.PLL_ENABLE */

    ADAU_TRY(adau1466_write_u16(hi2c, device_address_8bit, 0xF001U, 0x0002U)); /* IC 1.PLL_CTRL1 Register */

    ADAU_TRY(adau1466_write_u16(hi2c, device_address_8bit, 0xF002U, 0x0001U)); /* IC 1.PLL_CLK_SRC Register */

    ADAU_TRY(adau1466_write_u16(hi2c, device_address_8bit, 0xF005U, 0x0005U)); /* IC 1.MCLK_OUT Register */

    ADAU_TRY(adau1466_write_u16(hi2c, device_address_8bit, 0xF003U, 0x0001U)); /* IC 1.PLL_ENABLE Register */

    HAL_Delay(255U); /* IC 1.PLL Lock Delay */

    ADAU_TRY(adau1466_write_u16(hi2c, device_address_8bit, 0xF050U, 0x0CF0U)); /* IC 1.POWER_ENABLE0 Register */

    ADAU_TRY(adau1466_write_u16(hi2c, device_address_8bit, 0xF051U, 0x0018U)); /* IC 1.POWER_ENABLE1 Register */

    ADAU_TRY(adau1466_write_u16(hi2c, device_address_8bit, 0xF020U, 0x0012U)); /* IC 1.CLK_GEN1_M */

    ADAU_TRY(adau1466_write_u16(hi2c, device_address_8bit, 0xF022U, 0x0006U)); /* IC 1.CLK_GEN2_M */

    ADAU_TRY(adau1466_write_u16(hi2c, device_address_8bit, 0xF026U, 0x001EU)); /* IC 1.CLK_GEN3_SRC */

    ADAU_TRY(adau1466_write_u16(hi2c, device_address_8bit, 0xF443U, 0x7FFFU)); /* IC 1.WATCHDOG_MAXCOUNT */

    ADAU_TRY(adau1466_write_u16(hi2c, device_address_8bit, 0xF444U, 0x7FF0U)); /* IC 1.WATCHDOG_PRESCALE */

    ADAU_TRY(adau1466_write_u16(hi2c, device_address_8bit, 0xF450U, 0x7FFFU)); /* IC 1.BLOCKINT_EN */

    ADAU_TRY(adau1466_write_u16(hi2c, device_address_8bit, 0xF451U, 0xFFFFU)); /* IC 1.BLOCKINT_VALUE */

    ADAU_TRY(adau1466_write_u16(hi2c, device_address_8bit, 0xF462U, 0x7FFEU)); /* IC 1.PROG_CNTR_CLEAR */

    ADAU_TRY(adau1466_write_u16(hi2c, device_address_8bit, 0xF560U, 0x4669U)); /* IC 1.DMIC_CTRL0 */

    ADAU_TRY(adau1466_write_u16(hi2c, device_address_8bit, 0xF561U, 0x4769U)); /* IC 1.DMIC_CTRL1 */

    ADAU_TRY(adau1466_write_u16(hi2c, device_address_8bit, 0xF516U, 0x0009U)); /* IC 1.MP6_MODE */

    ADAU_TRY(adau1466_write_u16(hi2c, device_address_8bit, 0xF517U, 0x0009U)); /* IC 1.MP7_MODE */

    ADAU_TRY(adau1466_write_u16(hi2c, device_address_8bit, 0xF786U, 0x001AU)); /* IC 1.BCLK_OUT2_PIN */

    ADAU_TRY(adau1466_write_u16(hi2c, device_address_8bit, 0xF796U, 0x000AU)); /* IC 1.SDATA_OUT2_PIN */

    ADAU_TRY(adau1466_write_u16(hi2c, device_address_8bit, 0xF100U, 0x7F00U)); /* IC 1.ASRC_INPUT0 */

    ADAU_TRY(adau1466_write_u16(hi2c, device_address_8bit, 0xF101U, 0x7F00U)); /* IC 1.ASRC_INPUT1 */

    ADAU_TRY(adau1466_write_u16(hi2c, device_address_8bit, 0xF102U, 0x7F00U)); /* IC 1.ASRC_INPUT2 */

    ADAU_TRY(adau1466_write_u16(hi2c, device_address_8bit, 0xF103U, 0x7F00U)); /* IC 1.ASRC_INPUT3 */

    ADAU_TRY(adau1466_write_u16(hi2c, device_address_8bit, 0xF104U, 0x7F00U)); /* IC 1.ASRC_INPUT4 */

    ADAU_TRY(adau1466_write_u16(hi2c, device_address_8bit, 0xF105U, 0x7F00U)); /* IC 1.ASRC_INPUT5 */

    ADAU_TRY(adau1466_write_u16(hi2c, device_address_8bit, 0xF106U, 0x7F00U)); /* IC 1.ASRC_INPUT6 */

    ADAU_TRY(adau1466_write_u16(hi2c, device_address_8bit, 0xF107U, 0x7F00U)); /* IC 1.ASRC_INPUT7 */

    ADAU_TRY(adau1466_write_u16(hi2c, device_address_8bit, 0xF140U, 0x7FF0U)); /* IC 1.ASRC_OUT_RATE0 */

    ADAU_TRY(adau1466_write_u16(hi2c, device_address_8bit, 0xF141U, 0x7FF0U)); /* IC 1.ASRC_OUT_RATE1 */

    ADAU_TRY(adau1466_write_u16(hi2c, device_address_8bit, 0xF142U, 0x7FF0U)); /* IC 1.ASRC_OUT_RATE2 */

    ADAU_TRY(adau1466_write_u16(hi2c, device_address_8bit, 0xF143U, 0x7FF0U)); /* IC 1.ASRC_OUT_RATE3 */

    ADAU_TRY(adau1466_write_u16(hi2c, device_address_8bit, 0xF144U, 0x7FF0U)); /* IC 1.ASRC_OUT_RATE4 */

    ADAU_TRY(adau1466_write_u16(hi2c, device_address_8bit, 0xF145U, 0x7FF0U)); /* IC 1.ASRC_OUT_RATE5 */

    ADAU_TRY(adau1466_write_u16(hi2c, device_address_8bit, 0xF146U, 0x7FF0U)); /* IC 1.ASRC_OUT_RATE6 */

    ADAU_TRY(adau1466_write_u16(hi2c, device_address_8bit, 0xF147U, 0x7FF0U)); /* IC 1.ASRC_OUT_RATE7 */

    ADAU_TRY(adau1466_write_u16(hi2c, device_address_8bit, 0xF180U, 0x7FFAU)); /* IC 1.SOUT_SOURCE0 */

    ADAU_TRY(adau1466_write_u16(hi2c, device_address_8bit, 0xF181U, 0x7FFAU)); /* IC 1.SOUT_SOURCE1 */

    ADAU_TRY(adau1466_write_u16(hi2c, device_address_8bit, 0xF182U, 0x7FFAU)); /* IC 1.SOUT_SOURCE2 */

    ADAU_TRY(adau1466_write_u16(hi2c, device_address_8bit, 0xF183U, 0x7FFAU)); /* IC 1.SOUT_SOURCE3 */

    ADAU_TRY(adau1466_write_u16(hi2c, device_address_8bit, 0xF184U, 0x7FFAU)); /* IC 1.SOUT_SOURCE4 */

    ADAU_TRY(adau1466_write_u16(hi2c, device_address_8bit, 0xF185U, 0x7FFAU)); /* IC 1.SOUT_SOURCE5 */

    ADAU_TRY(adau1466_write_u16(hi2c, device_address_8bit, 0xF186U, 0x7FFAU)); /* IC 1.SOUT_SOURCE6 */

    ADAU_TRY(adau1466_write_u16(hi2c, device_address_8bit, 0xF187U, 0x7FFAU)); /* IC 1.SOUT_SOURCE7 */

    ADAU_TRY(adau1466_write_u16(hi2c, device_address_8bit, 0xF188U, 0x7FFAU)); /* IC 1.SOUT_SOURCE8 */

    ADAU_TRY(adau1466_write_u16(hi2c, device_address_8bit, 0xF189U, 0x7FFAU)); /* IC 1.SOUT_SOURCE9 */

    ADAU_TRY(adau1466_write_u16(hi2c, device_address_8bit, 0xF18AU, 0x7FFAU)); /* IC 1.SOUT_SOURCE10 */

    ADAU_TRY(adau1466_write_u16(hi2c, device_address_8bit, 0xF18BU, 0x7FFAU)); /* IC 1.SOUT_SOURCE11 */

    ADAU_TRY(adau1466_write_u16(hi2c, device_address_8bit, 0xF18CU, 0x7FFAU)); /* IC 1.SOUT_SOURCE12 */

    ADAU_TRY(adau1466_write_u16(hi2c, device_address_8bit, 0xF18DU, 0x7FFAU)); /* IC 1.SOUT_SOURCE13 */

    ADAU_TRY(adau1466_write_u16(hi2c, device_address_8bit, 0xF18EU, 0x7FFAU)); /* IC 1.SOUT_SOURCE14 */

    ADAU_TRY(adau1466_write_u16(hi2c, device_address_8bit, 0xF18FU, 0x7FFAU)); /* IC 1.SOUT_SOURCE15 */

    ADAU_TRY(adau1466_write_u16(hi2c, device_address_8bit, 0xF190U, 0x7FFAU)); /* IC 1.SOUT_SOURCE16 */

    ADAU_TRY(adau1466_write_u16(hi2c, device_address_8bit, 0xF191U, 0x7FFAU)); /* IC 1.SOUT_SOURCE17 */

    ADAU_TRY(adau1466_write_u16(hi2c, device_address_8bit, 0xF192U, 0x7FFAU)); /* IC 1.SOUT_SOURCE18 */

    ADAU_TRY(adau1466_write_u16(hi2c, device_address_8bit, 0xF193U, 0x7FFAU)); /* IC 1.SOUT_SOURCE19 */

    ADAU_TRY(adau1466_write_u16(hi2c, device_address_8bit, 0xF194U, 0x7FFAU)); /* IC 1.SOUT_SOURCE20 */

    ADAU_TRY(adau1466_write_u16(hi2c, device_address_8bit, 0xF195U, 0x7FFAU)); /* IC 1.SOUT_SOURCE21 */

    ADAU_TRY(adau1466_write_u16(hi2c, device_address_8bit, 0xF196U, 0x7FFAU)); /* IC 1.SOUT_SOURCE22 */

    ADAU_TRY(adau1466_write_u16(hi2c, device_address_8bit, 0xF197U, 0x7FFAU)); /* IC 1.SOUT_SOURCE23 */

    ADAU_TRY(adau1466_write_u16(hi2c, device_address_8bit, 0xF1C0U, 0x7FFFU)); /* IC 1.SPDIFTX_INPUT */

    ADAU_TRY(adau1466_write_u16(hi2c, device_address_8bit, 0xF200U, 0x9000U)); /* IC 1.SERIAL_BYTE_0_0 */

    ADAU_TRY(adau1466_write_u16(hi2c, device_address_8bit, 0xF204U, 0x9000U)); /* IC 1.SERIAL_BYTE_1_0 */

    ADAU_TRY(adau1466_write_u16(hi2c, device_address_8bit, 0xF208U, 0x9000U)); /* IC 1.SERIAL_BYTE_2_0 */

    ADAU_TRY(adau1466_write_u16(hi2c, device_address_8bit, 0xF20CU, 0x9018U)); /* IC 1.SERIAL_BYTE_3_0 */

    if(flag == 0) ADAU_TRY(adau1466_write_u16(hi2c, device_address_8bit, 0xF210U, 0x932CU)); /* IC 1.SERIAL_BYTE_4_0 */
    else 		  ADAU_TRY(adau1466_write_u16(hi2c, device_address_8bit, 0xF210U, 0x032CU)); /* IC 1.SERIAL_BYTE_4_0 */

    ADAU_TRY(adau1466_write_u16(hi2c, device_address_8bit, 0xF214U, 0x932CU)); /* IC 1.SERIAL_BYTE_5_0 */

    ADAU_TRY(adau1466_write_u16(hi2c, device_address_8bit, 0xF218U, 0x932CU)); /* IC 1.SERIAL_BYTE_6_0 */

    ADAU_TRY(adau1466_write_u16(hi2c, device_address_8bit, 0xF21CU, 0x932CU)); /* IC 1.SERIAL_BYTE_7_0 */

    ADAU_TRY(adau1466_write_block(hi2c, device_address_8bit, 0xC000U, s_program_data, (uint16_t)sizeof(s_program_data))); /* Program Data */

    ADAU_TRY(adau1466_write_block(hi2c, device_address_8bit, 0x0000U, s_dm0_data, (uint16_t)sizeof(s_dm0_data))); /* DM0 Data */

    ADAU_TRY(adau1466_write_block(hi2c, device_address_8bit, 0x6000U, s_dm1_data, (uint16_t)sizeof(s_dm1_data))); /* DM1 Data */

    ADAU_TRY(adau1466_write_u16(hi2c, device_address_8bit, 0xF403U, 0x0000U)); /* IC 1.KILL_CORE */

    ADAU_TRY(adau1466_write_u16(hi2c, device_address_8bit, 0xF404U, 0x0000U)); /* IC 1.START_ADDRESS */

    ADAU_TRY(adau1466_write_u16(hi2c, device_address_8bit, 0xF401U, 0x0002U)); /* IC 1.START_PULSE */

    ADAU_TRY(adau1466_write_u16(hi2c, device_address_8bit, 0xF402U, 0x0000U)); /* IC 1.START_CORE */

    ADAU_TRY(adau1466_write_u16(hi2c, device_address_8bit, 0xF402U, 0x0001U)); /* IC 1.START_CORE */

    HAL_Delay(1U); /* IC 1.Start Delay */

    ADAU_TRY(adau1466_write_u16(hi2c, device_address_8bit, 0xF400U, 0x0000U)); /* IC 1.HIBERNATE */

    g_adau1466_sigma_last_status = HAL_OK;
    return HAL_OK;
}

#undef ADAU_TRY
